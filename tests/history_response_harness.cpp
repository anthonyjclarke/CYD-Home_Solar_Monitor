#define ARDUINOJSON_ENABLE_ARDUINO_STRING 1
#define ARDUINOJSON_ENABLE_ARDUINO_STREAM 0
#define ARDUINOJSON_ENABLE_ARDUINO_PRINT 0
#define ARDUINOJSON_ENABLE_PROGMEM 0
#include <ArduinoJson.h>
#include "history_model.h"
#include <cassert>
#include <iostream>
#include <vector>

namespace history {
Store testStore;
uint32_t testEpoch = bucket(1793836800);
const Store& data() { return testStore; }
uint32_t now() { return testEpoch; }
bool storageReady() { return true; }
bool storageHealthy() { return true; }
uint32_t savedAt() { return 0; }
}
namespace monitor {
struct Config { bool demo = false; String tzName = "Test/Zone \"quoted\""; };
const Config& config() { static Config c; return c; }
}
constexpr size_t CONTENT_LENGTH_UNKNOWN = size_t(-1);
struct TestServer {
    bool hoursPresent = false;
    String hours;
    int status = 0;
    size_t contentLength = 0;
    std::vector<String> chunks;
    bool hasArg(const char*) const { return hoursPresent; }
    String arg(const char*) const { return hours; }
    void sendHeader(const char*, const char*) {}
    void setContentLength(size_t length) { contentLength = length; }
    void send(int code, const char*, const char* body) { status = code; chunks.emplace_back(body); }
    void sendContent(const String& body) { chunks.push_back(body); }
} server;
void error(const char*, int code = 400) { server.status = code; }

// Generated by check_history_response.py from the actual firmware handler.
#include "history_handler.inc"

int main(int argc, char** argv) {
    const std::string mode = argc > 1 ? argv[1] : "gaps";
    if (mode == "no-clock") history::testEpoch = 0;
    if (mode == "full" || mode == "mixed") {
        for (unsigned i = 0; i < history::capacity; ++i) {
            if (mode == "mixed" && i % 7 == 0) continue;
            history::Record r;
            r.slot = history::testEpoch - (history::capacity-1-i)*history::interval;
            r.capturedAt = r.slot;
            r.valid = history::allFields; r.sourceTimeKnown = 127;
            for (unsigned f = 0; f < history::FieldCount; ++f) r.values[f] = float(i+f) / 10;
            r.values[history::Grid] = -1527.25f; r.values[history::Battery] = 3904;
            if (mode == "mixed") r.valid &= ~(1U << history::Temperature);
            assert(history::testStore.add(r));
        }
    }
    if (mode == "bad-hours") { server.hoursPresent = true; server.hours = "12"; }
    if (mode == "explicit-hours") { server.hoursPresent = true; server.hours = "24"; }
    getHistory();
    if (mode == "bad-hours") { assert(server.status == 400 && server.chunks.empty()); return 0; }
    assert(server.status == 200 && server.contentLength == CONTENT_LENGTH_UNKNOWN);
    assert(server.chunks.back().length() == 0); // Terminate chunked transfer.
    if (history::testEpoch) assert(server.chunks.size() > 3); // Exercise packet flush boundaries.
    for (const auto& chunk : server.chunks) std::cout << chunk.c_str();
}
